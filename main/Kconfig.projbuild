## main/Kconfig.projbuild
```kconfig
menu "TIC-to-MQTT Configuration"

    config TIC_MODE
        int "Mode historique (0) ou standard (1)"
        range 0 1
        default 0
        help
            Configure la liaison TIC en mode historique ou en mode standard.

    config TIC_UART_RXD
        int "Pin utilisée pour recevoir la TIC"
        range 0 34 if IDF_TARGET_ESP32
        range 0 46 if IDF_TARGET_ESP32S2
        range 0 19 if IDF_TARGET_ESP32C3
        default 23
        help
            GPIO number for UART RX pin.

    config TIC_UART_STACK_SIZE
        int "Taille de la pile pour le décodage de la TIC"
        range 1024 16384
        default 4096
        help
            Defines stack size. Insufficient stack size can cause crash.

    config TIC_UART_BUFFER_SIZE
        int "UART internal buffer size"
        range 128 16384
        default 256
        help
            Defines buffer size.

    config TIC_UART_READ_BUFFER_SIZE
        int "UART reading buffer size"
        range 128 16384
        default 256
        help
            Defines buffer size.

    config TIC_UART_PORT_NUM
        int "UART port number"
        range 0 2 if IDF_TARGET_ESP32
        range 0 1 if IDF_TARGET_ESP32S2 || IDF_TARGET_ESP32C3
        default 2 if IDF_TARGET_ESP32
        default 1 if IDF_TARGET_ESP32S2 || IDF_TARGET_ESP32C3
        help
            UART communication port number for the example.
            See UART documentation for available port numbers.

    config MQTT_LWT_TOPIC
        string "MQTT Last Will Testament Topic"
        default "esp-tic/connected"
        help
            Topic where to send LWT (Last Will Testament) upon disconnect.

    config MQTT_COMMAND_TOPIC
        string "MQTT Last Will Testament Topic"
        default "esp-tic/command"
        help
            Topic where to send system commands.

    config MQTT_TIC_VALUE_TOPIC
        string "Where to send TIC values"
        default "esp-tic/status/tic/%s"
        help
            Topic where to send regular values received from TIC.

endmenu
```

## provision/main/Kconfig.projbuild
```kconfig
menu "Provisioning data"

    config ESP_WIFI_SSID
        string "WiFi SSID"
        default ""
        help
            SSID (network name) for the example to connect to.

    config ESP_WIFI_PASSWORD
        string "WiFi Password"
        default ""
        help
            WiFi password (WPA or WPA2) for the example to use.

    config ESP_MAXIMUM_RETRY
        int "Maximum retry"
        default 5
        help
            Set the Maximum retry to avoid station reconnecting to the AP unlimited when the AP is really inexistent.

    config MQTT_URI
        string "MQTT Server URI"
        default "mqtts://server:port"
        help
            MQTT server location.

    config MQTT_USERNAME
        string "MQTT username"
        default ""
        help
            MQTT username.

    config MQTT_PASSWORD
        string "MQTT password"
        default ""
        help
            MQTT password.

    config FIRMWARE_URL_PATTERN
        string "Firmware URL pattern"
        default ""
        help
            Where to download a specific version of the firmware. Complete URL. Must include "%s".

endmenu
```
